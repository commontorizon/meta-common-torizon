## conf/layer.conf
```bitbake
# We might have a conf and classes directory, append to BBPATH
BBPATH .= ":${LAYERDIR}"

# We have a recipes directory, add to BBFILES
BBFILES += "${LAYERDIR}/recipes*/*/*.bb ${LAYERDIR}/recipes*/*/*.bbappend"

BBFILE_COLLECTIONS += "meta-common-torizon"
BBFILE_PATTERN_meta-common-torizon := "^${LAYERDIR}/"
BBFILE_PRIORITY_meta-common-torizon = "90"

LAYERDEPENDS_meta-common-torizon = "toradex-bsp-common-layer meta-toradex-distro sota meta-toradex-security"
LAYERSERIES_COMPAT_meta-common-torizon = "kirkstone"

BBFILES_DYNAMIC += " \
    intel:${LAYERDIR}/dynamic-layers/intel/*/*/*.bbappend \
    riscv-layer:${LAYERDIR}/dynamic-layers/riscv/*/*/*.bbappend \
    raspberrypi:${LAYERDIR}/dynamic-layers/raspberrypi/*/*/*.bbappend \
    meta-ti-bsp:${LAYERDIR}/dynamic-layers/ti/*/*/*.bbappend \
"
```
